## test-peripheral/zephyr/west.yml
```yaml
manifest:
  remotes:
    - name: zephyrproject-rtos
      url-base: https://github.com/zephyrproject-rtos

  projects:
    - name: zephyr
      remote: zephyrproject-rtos
      revision: v4.4.2
      path: zephyr
      import:
        path-prefix: deps
        name-allowlist:
          - cmsis_6
          - hal_nordic
          - hal_espressif
          - mbedtls
          - tf-psa-crypto
          - segger
```
